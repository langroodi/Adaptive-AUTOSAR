AUTOSAR XML (schema 00050)
package /ExecutionManifest
  function group MachineFG
    mode-declaration-group initial-mode=Off:
      mode Off
      mode StartUp
