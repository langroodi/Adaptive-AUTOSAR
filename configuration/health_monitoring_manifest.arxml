AUTOSAR XML (schema 00050)
package /PlatformHealthManagementManifest
  global-supervision alive-supervision={alive-reference-cycle=100, checkpoint=0, expected-alive-indications=10, failed-reference-cycles-tolerance=150, max-margin=5, min-margin=5}, deadline-supervision={min-deadline=5, max-deadline=15, transition=checkpoint-transition={source=1, target=2}}:
    supervision checkpoint AliveSupervision: checkpoint-id=0
    supervision checkpoint DeadlineSupervisionSource: checkpoint-id=1
    supervision checkpoint DeadlineSupervisionTarget: checkpoint-id=2
