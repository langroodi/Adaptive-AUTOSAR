AUTOSAR XML (schema 00050)
package /ExtendedVehicleManifest
  elements provided-someip-service-instance={service-interface-deployment={service-interface-id=5, service-interface-version={major-version=1, minor-version=0}}, someip-provided-event-group{event-multicast-udp-port=5555, ipv-4-multicast-ip-address=239.0.0.1}, sd-server-config=initial-offer-behavior={initial-delay-min-value=100, initial-delay-max-value=200}, service-instance-id=0}:
    communication-cluster:
      ethernet physical channel Localhost
        network endpoint ExtendedVehicleEP: network-endpoint-addresses=ipv-4-configuration=ipv-4-address=127.0.0.1
    ethernet communication connector ExtendedVehicleConn
      ap application endpoint ServerUnicastTcp: tp-configuration=tcp-tp=tcp-tp-port=port-number=8081
